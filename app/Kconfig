## app/Kconfig
```kconfig
# Task scaffold definitions retained for subsequent porting.
# Not sourced by the active H743 BSP until these tasks and DPS368 are adapted.

menuconfig BSP_USING_FYPILOT
    bool "Enable FyPilot flight-control practice project"
    default y
    help
        Enable the minimal FyPilot scaffold used to port and study
        StarryPilot tasks on RT-Thread v5.x. Hardware integration is required.

if BSP_USING_FYPILOT

config FYPILOT_LOOP_HZ
    int "Initial flight loop frequency (Hz)"
    range 1 1000
    default 250

config FYPILOT_USING_DPS368
    bool "Automatically register DPS368 barometer"
    depends on RT_USING_I2C
    default n
    help
        Register the DPS368 as an RT-Thread device during application init.
        Keep disabled until the I2C bus and sensor are adapted for this board.
        The active H743 build does not currently compile this driver.

if FYPILOT_USING_DPS368

config FYPILOT_DPS368_DEVICE_NAME
    string "DPS368 RT-Thread device name"
    default "baro"

config FYPILOT_DPS368_I2C_BUS_NAME
    string "DPS368 I2C bus name"
    default "i2c1"

config FYPILOT_DPS368_I2C_ADDRESS
    hex "DPS368 7-bit I2C address"
    range 0x76 0x77
    default 0x77

endif
endif
```

## bsp/stm32h743/Kconfig
```kconfig
mainmenu "FyPilot / AOPAH743 standalone firmware"
BSP_DIR := .
RTT_DIR := ../../sdk/rt-thread
config SOC_FAMILY_STM32
    bool
    default y
config SOC_SERIES_STM32H7
    bool
    default y
    select ARCH_ARM_CORTEX_M7
config SOC_STM32H743VI
    bool
    default y
    select RT_USING_COMPONENTS_INIT
    select RT_USING_USER_MAIN
source "$(RTT_DIR)/Kconfig"
rsource "board/Kconfig"
```

## bsp/stm32h743/board/Kconfig
```kconfig
menu "AOPAH743 hardware"
config BSP_USING_HELLO_WORLD
    bool "Power-on Hello World demo (USART3, 115200 8N1)"
    default y
config BSP_USING_GPIO
    bool
    default y
    select RT_USING_PIN
config BSP_USING_UART
    bool
    default y
    select RT_USING_SERIAL
config BSP_USING_UART3
    bool
    default y
config BSP_USING_UART6
    bool "Register USART6 PC6/PC7 for receiver"
    default y if !BSP_USING_HELLO_WORLD
config BSP_USING_CRSF
    bool "CRSF receiver on USART6 PC7, 420000 baud"
    default y
    select BSP_USING_UART6
config BSP_CRSF_RX_BUFFER_SIZE
    int "CRSF interrupt receive FIFO bytes"
    depends on BSP_USING_CRSF
    range 256 4096
    default 1024
config BSP_CRSF_SIGNAL_TIMEOUT_MS
    int "CRSF RC frame freshness timeout (ms)"
    depends on BSP_USING_CRSF
    range 20 1000
    default 100
config BSP_STM32_UART_V1_TX_TIMEOUT
    int
    default 20
config BSP_USING_SPI
    bool
    default y
    select RT_USING_SPI
config BSP_USING_SPI4
    bool
    depends on BSP_USING_SPI
    default y
config BSP_SPI4_TX_USING_POLL
    bool
    depends on BSP_USING_SPI4
    default y
config BSP_SPI4_RX_USING_POLL
    bool
    depends on BSP_USING_SPI4
    default y
config BSP_SCB_ENABLE_I_CACHE
    bool "Enable instruction cache"
    default y
config BSP_SCB_ENABLE_D_CACHE
    bool "Enable data cache (DMA is disabled in this target)"
    default n
config BSP_USING_BMI270
    bool "BMI270 on SPI4, CS PE11, INT1 PE15"
    depends on BSP_USING_SPI4
    default y
endmenu
```
